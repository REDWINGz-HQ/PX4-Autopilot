## src/examples/new_pub_cpp/Kconfig
```kconfig
menuconfig EXAMPLES_NEW_PUB_CPP
	bool "new_pub_cpp"
	default n
	---help---
		Enable support for new_pub_cpp
```

## src/examples/new_subpub/Kconfig
```kconfig
menuconfig EXAMPLES_NEW_SUBPUB
	bool "new_subpub"
	default n
	---help---
		Enable support for new_subpub
```
